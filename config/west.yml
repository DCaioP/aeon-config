## config/west.yml
```yaml
manifest:
  remotes:
    # zmk official
    - name: zmkfirmware
      url-base: https://github.com/zmkfirmware
    - name: dsifry # custom screen
      url-base: https://github.com/dsifry # custom screen
  projects:
    - name: zmk
      remote: zmkfirmware
      revision: e93cd31a5866cd4f50385bece7a3fb770f2ca6f8 # main em 2025-07-03 (Zephyr 3.5)
      import: app/west.yml
    - name: nice-view-mod # custom screen
      remote: dsifry # custom screen
      revision: 5f328cce749b2760cb61dcac30db29432685af69 # custom screen
  self:
    path: config
```
